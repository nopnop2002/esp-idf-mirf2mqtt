## main/Kconfig.projbuild
```kconfig
menu "Application Configuration"

	menu "Radio Setting"

		choice DIRECTION
			prompt "Communication direction"
			default Receiver
			help
				Select Communication direction.
			config RECEIVER
				bool "Receiver"
				help
					Execute Receiver.
			config TRANSMITTER
				bool "Transmitter"
				help
					Execute Transmitter.
		endchoice

		config PAYLOAD_SIZE
			int "Payload size (byte)"
			range 1 32
			default 32
			help
				Payload size.

		config RECEIVER_ADDRESS
			depends on RECEIVER
			string "My address"
			default "FGHIJ"
			help
				My address.

		config DESTINATION_ADDRESS
			depends on TRANSMITTER
			string "Destination address"
			default "FGHIJ"
			help
				Destination address.

		config RADIO_CHANNEL
			int "Radio channel to use"
			range 1 127
			default 90
			help
				Radio channel to use.

	endmenu

	menu "WiFi Setting"

		config ESP_WIFI_SSID
			string "WiFi SSID"
			default "myssid"
			help
				SSID (network name) to connect to.

		config ESP_WIFI_PASSWORD
			string "WiFi Password"
			default "mypassword"
			help
				WiFi password (WPA or WPA2) to connect to.

		config ESP_MAXIMUM_RETRY
			int "Maximum retry"
			default 5
			help
				Set the Maximum retry to avoid station reconnecting to the AP unlimited when the AP is really inexistent.

	endmenu

	menu "MQTT Server Setting"


		config BROKER_URL
			string "Broker URL"
			default "mqtt://broker.emqx.io"
			help
				URL of the broker to connect to.

		config MQTT_TOPIC
			string "mqtt topic"
			default "/mirf"
			help
				mqtt topic.

	endmenu
endmenu 
```
